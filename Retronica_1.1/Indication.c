/*
 * indication.c
 *
 * Created: 22.01.2022 18:05:58
 *  Author: Evgeniy
 */ 
#define F_CPU 16000000UL //частота тактирования процессора

#include "Indication.h"
#include <avr/interrupt.h>
#include <util/delay.h>
#include "MenuSettings.h"

#define POINTS_ON          PORTD|=(1<<PD6)     //катоды точек в каждом индикаторе
#define POINTS_OFF         PORTD&=~(1<<PD6)

/************************************************************************/
/*					Таймер обработки динамической индикации		        */
/************************************************************************/
ISR (TIMER2_COMP_vect)//Прерывание таймера обработки динамической индикации
{
	static uint8_t counter_blink;		//счетчик
	static uint8_t show_indicator_flag;	//отображать число на лампе, если 1. Нужен, чтобы моргать настраиваемым параметром в режиме настройки
	static uint8_t Number;				//определяет с каким индикатоом работать в данный момент
	
	PORTB&=0xf0;	//отключаем аноды
	_delay_us(600);	//dead time для микросхемы дешифратора. Некоторые микросхемы без этой задержки делают засветки не нужных цифр в лампах
	PORTD&=0xf0;	//отключаем катоды
	POINTS_OFF;		//отключаем точки в индикаторах
	
	counter_blink++;	//счетчик и условия на моргание цифрой в режиме настройки
	if(counter_blink == 50)		 show_indicator_flag = 1;
	if(counter_blink == 100)	{show_indicator_flag = 0; counter_blink = 0;}
	
	if ((Ind[Number].blink && show_indicator_flag) || (!Ind[Number].blink))  //если show_indicator_flag=1, то отображаем цифру
	{
		if (Ind[Number].lamp != 10)		//если индикатор пустой, то не подавать на аноды напряжение
		{
			PORTD|=Ind[Number].lamp;	//выдаем на микросхему дешифратора число
			PORTB|=(1<<Number);		//подаем на анод высокое напряжение (3-Number) - инверсия индикаторов слева на право
			//показывать точку в режиме перебора будильников  ИЛИ  показывать точку если не в режиме перебора будильников И если включен И не в режиме настроек
			if ((selectable_alarm_point&&(alarm_number==Number)) ||  		//включает точку в меню настроек будильника при его выборе
			 (!selectable_alarm_point&&Alarm[Number].Al_status&&!no_points_global)) 
			 POINTS_ON;
		}
		
	}	
	Number++;	
	if (Number == 4) Number = 0;
}
/************************************************************************/
/*           Настройка таймера динамической индикации                   */
/************************************************************************/
void indicators_init(void)
{
	//таймер для индикации
	TCCR2|=(1<<WGM21)|(1<<CS20)|(1<<CS21)|(1<<CS22); //Режим "Сброс при совпадении", делитель 1024
	OCR2=50;    //50 - частота прерываний около 312,5 Гц или 78,125Гц на каждую лампу. 25 - 615 Гц, 153гц на одну лампу.
	TIMSK|=(1<<OCIE2); //прерывание при сравнении
}
