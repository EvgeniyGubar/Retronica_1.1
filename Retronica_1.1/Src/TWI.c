/*
 * TWI.c
 *
 * Created: 22.01.2022 13:08:37
 *  Author: Evgeniy
 */ 

#include "TWI.h"

#define F_CPU		16000000UL //частота тактирования процессора
#define F_I2C		100000UL                  //ЧАСТОТА РАБОТЫ ШИНЫ
#define TWBR_VALUE	(((F_CPU)/(F_I2C)-16)/2)

#if ((TWBR_VALUE > 255) || (TWBR_VALUE == 0))
#error "TWBR value is not correct"
#endif

/************************************************************************/
/*							ИНИЦИАЛИЗАЦИЯ                               */
/************************************************************************/
void i2c_Init(void)
{
	TWBR = TWBR_VALUE;
	TWSR = 0;
}
/************************************************************************/
/*				ФОРМИРОВАНИЕ СОСТОЯНИЯ СТАРТ НА ШИНЕ                    */
/************************************************************************/
void i2c_start_cond(void)
{
	TWCR=(1<<TWINT)|(1<<TWSTA)|(1<<TWEN);   //формируем состояние старт
	while(!(TWCR&(1<<TWINT)));              //ждем, когда установится флаг успешной операции TWINT
}
/************************************************************************/
/*						ОТПРАВКА БАЙТА ДАННЫХ                           */
/************************************************************************/
void i2c_send_byte (unsigned char data)
{
	TWDR=data;                              //запись в регистр данных байта информации
	TWCR=(1<<TWINT)|(1<<TWEN);              //отправка
	while(!(TWCR&(1<<TWINT)));              //ждем, когда установится флаг успешной операции TWINT
}
/************************************************************************/
/*				ФОРМИРОВАНИЕ СОСТОЯНИЯ СТОП НА ШИНЕ                     */
/************************************************************************/
void i2c_stop_cond(void)
{
	TWCR=(1<<TWINT)|(1<<TWSTO)|(1<<TWEN);   //формируем состояние стоп
}
/************************************************************************/
/*						ЧТЕНИЕ БАЙТА ДАННЫХ                             */
/************************************************************************/
uint8_t i2c_get_byte(void)    //0-с подтверждением, 1-без него   uint8_t ack
{
	uint8_t data=0;
	
	// 	if (ack==0)  //чтение с подтвержением
	// 	{
	// 		TWCR = (1<<TWINT)|(1<<TWEA)|(1<<TWEN);
	// 		while(!(TWCR & (1<<TWINT)));
	// 		data = TWDR;
	// 	}
	// 	if (ack==1)
	//чтение без подтверждения
	//{
	TWCR = (1<<TWINT)|(1<<TWEN);
	while(!(TWCR & (1<<TWINT)));
	data = TWDR;
	//	};
	return data;
}
